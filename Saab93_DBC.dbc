VERSION ""

NS_ :

BS_:

BU_: XXX 6

BO_ 193 NEW_MSG_1: 8 XXX
 SG_ E : NaN|NaN@0+ (NaN,1) [5|NaN] "1" 6

BO_ 272 Engine Speed: 7 XXX
 SG_ Engine Speed : 15|16@0+ (1,0) [0|65535] "rpm" XXX
 SG_ AccPos : 31|8@0+ (0.392157,0) [0|100] "%" XXX
